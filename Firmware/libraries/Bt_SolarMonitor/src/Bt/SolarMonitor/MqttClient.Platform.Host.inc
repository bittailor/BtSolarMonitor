//*************************************************************************************************
//
//  BITTAILOR.CH - Bt::SolarMonitor::MqttClient
//
//*************************************************************************************************

#include "Bt/SolarMonitor/MqttClient.Platform.Host.hpp"

namespace Bt {
namespace SolarMonitor {

//-------------------------------------------------------------------------------------------------

MqttClient::MqttClient()
{

}

//-------------------------------------------------------------------------------------------------

MqttClient::~MqttClient() {

}

//-------------------------------------------------------------------------------------------------

void MqttClient::begin() {

}

//-------------------------------------------------------------------------------------------------

bool MqttClient::connect() {
   return true;
}

//-------------------------------------------------------------------------------------------------

bool MqttClient::isConnected() {
   return true;
}

//-------------------------------------------------------------------------------------------------

bool MqttClient::yield(uint32_t pTimeoutInMilliseconds) {
   return true;
}

//-------------------------------------------------------------------------------------------------

bool MqttClient::publish(const char* pTopicName, void* pPayload, size_t pPayloadlen, QoS pQos, bool pRetained){
   return true;
}

//-------------------------------------------------------------------------------------------------

bool MqttClient::publish(const char* pTopicName, const char* pMessage, QoS pQos, bool pRetained) {
   return true;
}

//-------------------------------------------------------------------------------------------------


//-------------------------------------------------------------------------------------------------

} // namespace SolarMonitor
} // namespace Bt
