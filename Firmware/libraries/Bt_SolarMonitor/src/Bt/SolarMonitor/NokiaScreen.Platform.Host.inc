//*************************************************************************************************
//
//  BITTAILOR.CH - Bt::SolarMonitor::NokiaScreen
//
//*************************************************************************************************

#include "Bt/SolarMonitor/NokiaScreen.hpp"

namespace Bt {
namespace SolarMonitor {


//-------------------------------------------------------------------------------------------------

NokiaScreen::NokiaScreen(int8_t pDCPin, int8_t pCSPin, int8_t pRSTPin) {

}

//-------------------------------------------------------------------------------------------------

NokiaScreen::~NokiaScreen() {

}

//-------------------------------------------------------------------------------------------------

void NokiaScreen::begin() {
}

//-------------------------------------------------------------------------------------------------

void NokiaScreen::clear() {
}

//-------------------------------------------------------------------------------------------------

void NokiaScreen::display(void) {
}

//-------------------------------------------------------------------------------------------------

void NokiaScreen::setTextSize(uint8_t pSize) {
}

//-------------------------------------------------------------------------------------------------

void NokiaScreen::setTextColor(uint16_t pColor) {
}

//-------------------------------------------------------------------------------------------------

size_t NokiaScreen::print(const char* pString) {
   return 0;
}

//-------------------------------------------------------------------------------------------------

size_t NokiaScreen::print(char pChar) {
   return 0;
}

//-------------------------------------------------------------------------------------------------

size_t NokiaScreen::print(int pInt) {
   return 0;
}

//-------------------------------------------------------------------------------------------------

size_t NokiaScreen::print(double pDouble, int pDigits) {
   return 0;
}

//-------------------------------------------------------------------------------------------------

size_t NokiaScreen::println(const char* pString) {
   return 0;
}

//-------------------------------------------------------------------------------------------------

size_t NokiaScreen::println(char pChar) {
   return 0;
}

//-------------------------------------------------------------------------------------------------

size_t NokiaScreen::println(int pInt) {
   return 0;
}

//-------------------------------------------------------------------------------------------------

size_t NokiaScreen::println(double pDouble, int pDigits) {
   return 0;
}

//-------------------------------------------------------------------------------------------------

} // namespace SolarMonitor
} // namespace Bt

